# Builds apimain from this tree and overlays it on the upstream release image, which
# already carries the matching admin frontend, conf and docs for that version.
ARG BASE_IMAGE=lejianwen/rustdesk-api:v2.7

FROM golang:1.23-alpine AS builder
RUN apk add --no-cache gcc musl-dev
WORKDIR /src
COPY . .
# go.sum is gitignored upstream; tidy regenerates it the same way Dockerfile.dev does.
RUN go mod tidy \
    && go test ./http/middleware/ \
    && CGO_ENABLED=1 go build -ldflags "-s -w -extldflags '-static'" -o /out/apimain ./cmd/apimain.go

FROM ${BASE_IMAGE}
COPY --from=builder /out/apimain /app/apimain
# The admin frontend hardcodes a few Chinese strings outside its translation tables, so
# they show in every language. Each must be found: a base image that moved them fails the
# build instead of shipping them untranslated.
RUN cd /app/resources/admin \
    && for s in '"多个IP以 | 分割"' '", 全部填 "' '"请选择颜色"'; do \
        grep -rqF "$s" . || { echo "not found: $s" >&2; exit 1; }; \
    done \
    && grep -rlF -e '多个IP以' -e '全部填' -e '请选择颜色' . | xargs sed -i \
        -e 's#"多个IP以 | 分割"#"Separate multiple IPs with |"#g' \
        -e 's#", 全部填 "#"To remove all, enter "#g' \
        -e 's#"请选择颜色"#"Please select a color"#g' \
    && ! grep -rqF -e '多个IP以' -e '全部填' -e '请选择颜色' .
